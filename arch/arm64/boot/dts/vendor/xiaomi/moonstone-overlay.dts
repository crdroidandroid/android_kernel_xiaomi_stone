/dts-v1/;
/plugin/;

/ {
	model = "Qualcomm Technologies, Inc. MOONSTONE QRD NOPMI";
	compatible = "qcom,blair-qrd", "qcom,blair", "qcom,qrd";
	qcom,msm-id = <507 0x10000>;
	qcom,board-id = <0x1000B 0>;
	qcom,pmic-id-size = <4>;
	qcom,pmic-id = <0x2D 0x0 0x0 0x0>;
};

&soc {
};
