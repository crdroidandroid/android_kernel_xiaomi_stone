&qupv3_se7_i2c_sleep {
	config {
		/delete-property/ bias-disable;
		bias-pull-up;
		input-enable;
	};
};

&qupv3_se10_i2c_sleep {
	config {
		/delete-property/ bias-disable;
		bias-pull-up;
		input-enable;
	};
};
