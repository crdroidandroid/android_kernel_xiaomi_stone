&qupv3_se0_i2c {
	status = "ok";

	/delete-node/ nq@28;

	st21nfc@8 {
		clkreq-gpios = <&tlmm 7 0>;
		clock-names = "nfc_ref_clk";
		compatible = "st,st21nfc";
		interrupt-parent = <&tlmm>;
		interrupts = <9 0>;
		irq-gpios = <&tlmm 9 0>;
		pinctrl-0 = <&nfc_int_active
			&nfc_enable_active>;
		pinctrl-1 = <&nfc_int_suspend
			&nfc_enable_suspend>;
		pinctrl-names = "nfc_active", "nfc_suspend";
		reg = <0x08>;
		reset-gpios = <&tlmm 6 0>;
		st,clk_pinctrl;
		status = "ok";
	};
};
