#include "dsi-panel-m17-38-0c-0a-fhdp-dsc-video.dts"
#include "dsi-panel-m17-k6s-38-0c-0a-fhdp-dsc-video.dts"

&display_panel_avdd {
	/delete-property/ gpio;
	/delete-property/ enable-active-high;
};

&sde_dsi {
	qcom,dsi-default-panel = <&dsi_m17_38_0c_0a_fhd_dsc_video
		&dsi_m17_k6s_38_0c_0a_fhd_dsc_video>;
};
