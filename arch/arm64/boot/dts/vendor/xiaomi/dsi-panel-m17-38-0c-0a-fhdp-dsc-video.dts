&mdss_mdp {
	dsi_m17_38_0c_0a_fhd_dsc_video: qcom,mdss_dsi_m17_38_0c_0a_fhdp_dsc_vid {
		qcom,mdss-dsi-panel-name = "xiaomi m17 38 0c 0a fhd dsc video dsi panel";
		qcom,mdss-dsi-panel-id = <0>;
		qcom,dsi-ctrl-num = <0>;
		qcom,dsi-phy-num = <0>;
		qcom,mdss-dsi-panel-type = "dsi_video_mode";
		qcom,mdss-dsi-virtual-channel-id = <0>;
		qcom,mdss-dsi-stream = <0>;
		qcom,mdss-dsi-bpp = <24>;
		qcom,mdss-dsi-color-order = "rgb_swap_rgb";
		qcom,mdss-dsi-underflow-color = <0xff>;
		qcom,mdss-dsi-border-color = <0>;
		qcom,mdss-dsi-traffic-mode = "burst_mode";
		qcom,mdss-dsi-bllp-eof-power-mode;
		qcom,mdss-dsi-bllp-power-mode;
		qcom,mdss-dsi-lp11-init;
		qcom,mdss-dsi-lane-0-state;
		qcom,mdss-dsi-lane-1-state;
		qcom,mdss-dsi-lane-2-state;
		qcom,mdss-dsi-lane-3-state;
		qcom,bl-update-flag = "delay_until_first_frame";
		qcom,mdss-dsi-dma-trigger = "trigger_sw";
		qcom,mdss-dsi-mdp-trigger = "none";
		qcom,mdss-dsi-bl-dcs-type-ss-ea;
		qcom,mdss-dsi-reset-sequence = <0 10>, <1 10>;
		qcom,mdss-pan-physical-width-dimension = <696>;
		qcom,mdss-pan-physical-height-dimension = <1546>;
		qcom,mdss-dsi-tx-eot-append;
		qcom,esd-err-irq-gpio = <&tlmm 97 0x2002>;
		qcom,mdss-dsi-pan-enable-dynamic-fps;
		qcom,mdss-dsi-pan-fps-update = "dfps_immediate_porch_mode_vfp";
		qcom,dsi-supported-dfps-list = <120 90 60>;
		mi,mdss-dsi-doze-hbm-brightness-value = <272>;
		mi,mdss-dsi-doze-lbm-brightness-value = <22>;
		qcom,mdss-dsi-oled-panel-video-mode;
		qcom,dispparam-enabled;
		qcom,panel-read-enabled;
		qcom,dsi-dyn-clk-enable;
		qcom,dsi-dyn-clk-type = "constant-fps-adjust-vfp";
		qcom,dsi-dyn-clk-list = <1099653120 1108000024>;
		qcom,dsi-select-clocks = "mux_byte_clk0", "mux_pixel_clk0", "src_byte_clk0", "src_pixel_clk0", "shadow_byte_clk0", "shadow_pixel_clk0";
		qcom,panel-supply-entries = <&dsi_panel_pwr_supply_avdd>;
		qcom,mdss-dsi-bl-pmic-control-type = "bl_ctrl_dcs";
		qcom,mdss-dsi-bl-min-level = <4>;
		qcom,mdss-dsi-bl-max-level = <2047>;
		qcom,mdss-brightness-max-level = <2047>;
		qcom,platform-en-gpio = <&tlmm 24 GPIO_ACTIVE_HIGH>;
		qcom,platform-te-gpio = <&tlmm 23 GPIO_ACTIVE_HIGH>;
		qcom,platform-reset-gpio = <&pmr735a_gpios 2 GPIO_ACTIVE_HIGH>;

		qcom,mdss-dsi-display-timings {
			timing@0 {
				qcom,mdss-dsi-panel-width = <1080>;
				qcom,mdss-dsi-panel-height = <2400>;
				qcom,mdss-dsi-h-front-porch = <120>;
				qcom,mdss-dsi-h-back-porch = <120>;
				qcom,mdss-dsi-h-pulse-width = <28>;
				qcom,mdss-dsi-h-sync-skew = <0>;
				qcom,mdss-dsi-v-back-porch = <10>;
				qcom,mdss-dsi-v-front-porch = <20>;
				qcom,mdss-dsi-v-pulse-width = <2>;
				qcom,mdss-dsi-h-left-border = <0>;
				qcom,mdss-dsi-h-right-border = <0>;
				qcom,mdss-dsi-v-top-border = <0>;
				qcom,mdss-dsi-v-bottom-border = <0>;
				qcom,mdss-dsi-panel-framerate = <120>;
				qcom,mdss-dsi-on-command = <0x39010000 0x3f0 0x5a5a3901 0x0 0x3f15a5a 0x39010000 0x2d0 0x8390100 0x04 0xb00025f2 0x39010000 0x2f2 0x50390100 0x04 0xb0002ff2 0x39010000 0x2f2 0x27390100 0x03 0xf0a5a539 0x1000000 0x3f1a5 0xa5050100 0x140002 0x11003901 0x0 0x3f05a5a 0x39010000 0x3b2 0x1313901 0x0 0x8df0930 0x9543a943 0xa9390100 0x03 0xf0a5a539 0x1000000 0x29d01 0x39010000 0x5a9e 0x11000089 0x30800960 0x4380028 0x21c021c 0x200020e 0x2003dd 0x7000c 0x277028b 0x180010f0 0x30c2000 0x60b0b33 0xe1c2a38 0x46546269 0x7077797b 0x7d7e0102 0x1000940 0x9be19fc 0x19fa19f8 0x1a381a78 0x1ab62af6 0x2b342b74 0x3b746bf4 0x390100 0x03 0xf05a5a39 0x1000000 0x26001 0x39010000 0x2f7 0xb390100 0x03 0xf0a5a539 0x1000000 0x3f05a 0x5a390100 0x04 0xb00040f2 0x39010000 0x2f2 0x3390100 0x03 0xf0a5a539 0x1000000 0x3f05a 0x5a390100 0x04 0xb00015f6 0x39010000 0x2f6 0xf0390100 0x04 0xb00028f6 0x39010000 0x2f6 0xf0390100 0x04 0xb0003bf6 0x39010000 0x2f6 0xf0390100 0x04 0xb0000af4 0x39010000 0x2f4 0x98390100 0x04 0xb00011f4 0x39010000 0x2f4 0xee390100 0x04 0xb00018b2 0x39010000 0x2b2 0x1c390100 0x03 0xfc5a5a39 0x0 0x4b000 0x11fe3900 0x0 0x2fe0039 0x1000000 0x3fca5 0xa5390100 0x04 0xb0000db2 0x39010000 0x2b2 0x5390100 0x04 0xb0000cb2 0x39010000 0x2b2 0x30390100 0x02 0xf70b3901 0x0 0x3f0a5a5 0x39010000 0x3f0 0x5a5a3901 0x0 0x3fc5a5a 0x39010000 0x4ed 0x1cd0039 0x1000000 0x2e193 0x39010000 0x4b0 0x6f439 0x1000000 0x2f41f 0x39010000 0x3f0 0xa5a53901 0x0 0x3fca5a5 0x39010000 0x253 0x28390100 0x640003 0x51000005 0x1000000 0x22900>;
				qcom,mdss-dsi-pre-off-command = [05 01 00 00 14 00 02 28 00 05 01 00 00 96 00 02 10 00];
				qcom,mdss-dsi-on-command-state = "dsi_lp_mode";
				qcom,mdss-dsi-pre-off-command-state = "dsi_hs_mode";
				qcom,mdss-dsi-dispparam-dimmingon-command = [39 01 00 00 01 00 02 53 28];
				qcom,mdss-dsi-dispparam-dimmingon-command-state = "dsi_lp_mode";
				qcom,mdss-dsi-dispparam-dimmingoff-command = [39 01 00 00 01 00 02 53 20];
				qcom,mdss-dsi-dispparam-dimmingoff-command-state = "dsi_lp_mode";
				qcom,mdss-dsi-dispparam-dimming-hbmon-command = [39 01 00 00 00 00 03 f0 5a 5a 39 01 00 00 00 00 04 b0 00 0d b2 39 01 00 00 00 00 02 b2 30 39 01 00 00 00 00 04 b0 00 0c b2 39 01 00 00 00 00 02 b2 30 39 01 00 00 00 00 02 f7 0b 39 01 00 00 00 00 03 f0 a5 a5];
				qcom,mdss-dsi-dispparam-dimming-hbmon-command-state = "dsi_hs_mode";
				qcom,mdss-dsi-dispparam-dimming-hbmoff-command = [39 01 00 00 00 00 03 f0 5a 5a 39 01 00 00 00 00 04 b0 00 0d b2 39 01 00 00 00 00 02 b2 05 39 01 00 00 00 00 04 b0 00 0c b2 39 01 00 00 00 00 02 b2 30 39 01 00 00 00 00 02 f7 0b 39 01 00 00 00 00 03 f0 a5 a5];
				qcom,mdss-dsi-dispparam-dimming-hbmoff-command-state = "dsi_hs_mode";
				qcom,mdss-dsi-dispparam-hbm-on-l1-command = <0x39010000 0x253 0xe8390100 0x03 0x51025839 0x1000000 0x2f70b>;
				qcom,mdss-dsi-dispparam-hbm-on-l1-command-state = "dsi_lp_mode";
				qcom,mdss-dsi-dispparam-hbm-on-l2-command = <0x39010000 0x253 0xe8390100 0x03 0x5104b039 0x1000000 0x2f70b>;
				qcom,mdss-dsi-dispparam-hbm-on-l2-command-state = "dsi_lp_mode";
				qcom,mdss-dsi-dispparam-hbm-on-l3-command = <0x39010000 0x253 0xe8390100 0x03 0x5107ff39 0x1000000 0x2f70b>;
				qcom,mdss-dsi-dispparam-hbm-on-l3-command-state = "dsi_lp_mode";
				qcom,mdss-dsi-dispparam-hbm-off-command = [39 00 00 00 00 00 02 53 28 39 01 00 00 00 00 03 51 07 ff];
				qcom,mdss-dsi-dispparam-hbm-off-command-state = "dsi_lp_mode";
				qcom,mdss-dsi-doze-hbm-command = [39 01 00 00 00 00 03 51 01 10];
				qcom,mdss-dsi-doze-hbm-command-state = "dsi_lp_mode";
				qcom,mdss-dsi-doze-lbm-command = [39 01 00 00 00 00 03 51 00 16];
				qcom,mdss-dsi-doze-lbm-command-state = "dsi_lp_mode";
				qcom,mdss-dsi-dispparam-flat-mode-on-command = <0x39010000 0x3f0 0x5a5a3901 0x0 0x4b00089 0xb1390100 0x02 0xb12d3901 0x0 0x4b00003 0xb8390100 0x05 0xb8ff8f01 0xff390100 0x04 0xb000f8b5 0x39010000 0xfb5 0x82171717 0x86fb0a80 0x0 0xff903901 0x0 0x3f0a5a5>;
				qcom,mdss-dsi-dispparam-flat-mode-on-command-state = "dsi_hs_mode";
				qcom,mdss-dsi-dispparam-flat-mode-off-command = <0x39010000 0x3f0 0x5a5a3901 0x0 0x4b00089 0xb1390100 0x02 0xb10d3901 0x0 0x4b00003 0xb8390100 0x05 0xb8ff8f01 0xff390100 0x04 0xb000f8b5 0x39010000 0xfb5 0x82171717 0x86fb0a80 0x0 0xff903901 0x0 0x3f0a5a5>;
				qcom,mdss-dsi-dispparam-flat-mode-off-command-state = "dsi_hs_mode";
				qcom,mdss-dsi-dispparam-bc-120hz-command = [39 00 00 00 00 00 03 f0 5a 5a 39 00 00 00 00 00 02 60 01 39 00 00 00 00 00 02 f7 0b 39 01 00 00 00 00 03 f0 a5 a5];
				qcom,mdss-dsi-dispparam-bc-120hz-command-state = "dsi_hs_mode";
				qcom,mdss-dsi-dispparam-bc-90hz-command = [39 00 00 00 00 00 03 f0 5a 5a 39 00 00 00 00 00 02 60 01 39 00 00 00 00 00 02 f7 0b 39 01 00 00 00 00 03 f0 a5 a5];
				qcom,mdss-dsi-dispparam-bc-90hz-command-state = "dsi_hs_mode";
				qcom,mdss-dsi-dispparam-bc-60hz-command = <0x39000000 0x3f0 0x5a5a3900 0x0 0x2602139 0x1000000 0x2f70b>;
				qcom,mdss-dsi-dispparam-bc-60hz-command-state = "dsi_hs_mode";
				/*
				qcom,mdss-dsi-dispparam-bc-30hz-command = [39 00 00 00 00 00 03 f0 5a 5a 39 00 00 00 00 00 02 60 01 39 00 00 00 00 00 02 f7 0b 39 01 00 00 00 00 03 f0 a5 a5];
				qcom,mdss-dsi-dispparam-bc-30hz-command-state = "dsi_lp_mode";
				*/
				qcom,compression-mode = "dsc";
				qcom,mdss-dsc-version = <0x11>;
				qcom,mdss-dsc-scr-version = <0>;
				qcom,mdss-dsc-slice-height = <20>;
				qcom,mdss-dsc-slice-width = <540>;
				qcom,mdss-dsc-slice-per-pkt = <2>;
				qcom,mdss-dsc-bit-per-component = <8>;
				qcom,mdss-dsc-bit-per-pixel = <8>;
				qcom,mdss-dsc-block-prediction-enable;
				qcom,mdss-dsi-dispparam-60hz-dc-crc-setting-command = <0x39000000 0x3f0 0x5a5a3900 0x0 0x2800539 0x0 0x2b100 0x39000000 0x4b0 0x1b139 0x0 0x16b101 0x01 0x01 0x10101 0x10101 0x10101 0x39000000 0x3f0 0xa5a53901 0x0 0x35101e8>;
				qcom,mdss-dsi-dispparam-60hz-dc-crc-setting-command-state = "dsi_lp_mode";
				qcom,mdss-dsi-dispparam-120hz-dc-crc-setting-command = <0x39010000 0x3f0 0x5a5a3900 0x0 0x2800539 0x0 0x2b100 0x39000000 0x4b0 0x1b139 0x0 0x16b101 0x01 0x01 0x10101 0x10101 0x10101 0x39000000 0x3f0 0xa5a53901 0x0 0x35101e8>;
				qcom,mdss-dsi-dispparam-120hz-dc-crc-setting-command-state = "dsi_hs_mode";
				qcom,mdss-dsi-dispparam-seed-control-command = [39 01 00 00 00 00 03 f0 5a 5a 39 01 00 00 00 00 02 80 05 39 01 00 00 00 00 02 b1 00 39 01 00 00 00 00 04 b0 00 01 b1 39 01 00 00 00 00 16 b1 c9 00 00 16 cc 02 07 0b b5 21 ef de e5 0d d3 ee df 02 ff ff ff 39 01 00 00 00 00 03 f0 a5 a5];
				qcom,mdss-dsi-dispparam-seed-control-command-state = "dsi_hs_mode";
				qcom,mdss-dsi-dispparam-crc-off-command = [39 00 00 00 00 00 03 f0 5a 5a 39 00 00 00 00 00 02 80 00 39 00 00 00 00 00 02 b1 01 39 01 00 00 00 00 03 f0 a5 a5];
				qcom,mdss-dsi-dispparam-crc-off-command-state = "dsi_lp_mode";
				qcom,mdss-dsi-panel-phy-timings = [00 24 0a 0a 1a 19 09 0a 09 02 04 00 1e 0f];
				qcom,display-topology = <1 1 1>;
				qcom,default-topology-index = <0>;
			};
		};
	};
};
